## boards/hfn_f411ce/Kconfig.defconfig
```kconfig
# Copyright (c) 2020 Brian Bradley
# SPDX-License-Identifier: Apache-2.0

# F411CE based HFN F411CE V2.0+ board board configuration

if BOARD_HFN_F411CE

config SPI_STM32_INTERRUPT
	default y
	depends on SPI

endif # BOARD_HFN_F411CE
```

## boards/hfn_f411ce/board.yml
```yaml
board:
  name: hfn_f411ce
  full_name: hfn f411ce V2.0
  vendor: hfn
  socs:
    - name: stm32f411xe
```
